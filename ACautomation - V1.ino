//-------------------------Bibliotecas
#include <SPI.h>
#include <Wire.h>
#include <IRremoteESP8266.h>
#include <IRsend.h>
#include <PubSubClient.h>
#include <ESP8266WiFi.h>
#include <Adafruit_GFX.h>
#include <Adafruit_SSD1306.h>

#define PIN_AR 14
#define PIN_PIR D0
//-------------------------Config. OLED
#define OLED_RESET LED_BUILTIN
Adafruit_SSD1306 display(OLED_RESET);

#if (SSD1306_LCDHEIGHT != 64)
#error("Height incorrect, please fix Adafruit_SSD1306.h!");
#endif

//-------------------------Config. DHT
#include "DHT.h"
#define DHTPIN 2     // Pino de Leitura
#define DHTTYPE DHT22

//-------------------------Config MQTT
#define TOPICO_SUBSCRIBE "CAP_AR"
#define TOPICO_PUBLISH   "DHT/Temp"
#define TOPICO_PUBLISH2 "DHT/Umi"
#define TOPICO_PUBLISH3 "PIR/present"
#define ID_MQTT  "NodeMCUCAP"

//-------------------------Config. conexões MQTT e Wi-fi
//const char* SSID = "CAP1";
//const char* PASSWORD = "cap2009sala90";

const char* SSID = "Net-Virtua-6929";
const char* PASSWORD = "20369290";

const char* BROKER_MQTT = "200.129.242.4";
int BROKER_PORT = 20049;

//-------------------------parametros de função
DHT dht(DHTPIN, DHTTYPE);
WiFiClient espClient;
PubSubClient MQTT(espClient);

//-------------------------variaveis
String message;
int intHumid;
int intTemp;
int ldrPin = A0;  //DEFINE O PINO NO QUAL O SENSOR DE LUMINOSIDADE LDR ESTARA CONECTADO ADC0 OU A0 NO NODEMCU
int ldrValor = 0; //VALOR LIDO DO SENSOR DE LUMINOSIDADE LDR
int countHERE = 0;
int PIRbef = 0;
float humid;
float temp;
float ldrValorSend;


IRsend irsend(PIN_AR);

//-------------------------Sinais infravermoelhos
short unsigned int Desligar[197] = {6152, 7360, 592, 1612, 588, 1616, 588, 1616, 560, 1644, 560, 1640, 564,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 7380, 592};
short unsigned int Ligar20C[197] = {6172, 7336, 588, 1612, 592, 1616, 588, 1616, 560, 1644, 560, 1644, 564,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 7380, 588};
short unsigned int Temp16C[197] = {6160, 7328, 592, 1644, 564, 1616, 592, 1612, 592, 1612, 564, 1612, 596,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 7360, 612};
short unsigned int Temp17C[197] = {6148, 7364, 584, 1616, 592, 1612, 588, 1612, 568, 1640, 564, 1616, 588,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 7380, 592};
short unsigned int Temp18C[197] = {6152, 7336, 612, 1612, 568, 1640, 564, 1616, 592, 1612, 588, 1612, 596,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 7352, 620};
short unsigned int Temp19C[197] = {6160, 7352, 596, 1612, 588, 1612, 564, 1644, 568, 1612, 592, 1612, 592,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 7376, 596};
short unsigned int Temp20C[197] = {6152, 7360, 588, 1612, 596, 1612, 564, 1636, 564, 1616, 592, 1616, 592,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 7380, 596};

//-------------------------Parametros do temporizador
os_timer_t mTimer;
bool _timeout = false;

//-------------------------Icone do logo CAP
static const unsigned char PROGMEM logoCAP [] = {
  0x00, 0x00, 0x00, 0x00, 0x00, 0x00, 0x00, 0x00, 0x00, 0x00, 0x00, 0x00, 0x00, 0x00, 0x00, 0x00,
  0x00, 0x00, 0x00, 0x00, 0x00, 0x00, 0x00, 0x00, 0x00, 0x00, 0x00, 0x00, 0x00, 0x00, 0x00, 0x00,
  0x00, 0x00, 0x00, 0x00, 0x00, 0x00, 0x00, 0x00, 0x00, 0x00, 0x00, 0x00, 0x00, 0x00, 0x00, 0x00,
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  0x00, 0x00, 0x00, 0x00, 0x00, 0x00, 0x00, 0x00, 0x00, 0x00, 0x00, 0x00, 0x00, 0x00, 0x00, 0x00
};

//-------------------------Icone de Wifi On
static const unsigned char PROGMEM wifiON [] = {
  0x00, 0x00, 0x00, 0x00, 0x00, 0x00, 0x01, 0xf8, 0x00, 0x0f, 0xff, 0x00, 0x3e, 0x07, 0xc0, 0x70,
  0x00, 0xe0, 0xe1, 0xf8, 0x70, 0x47, 0xfe, 0x20, 0x0e, 0x07, 0x80, 0x18, 0x01, 0x80, 0x00, 0xf0,
  0x00, 0x03, 0xfc, 0x00, 0x03, 0x0c, 0x00, 0x00, 0x00, 0x00, 0x00, 0x60, 0x00, 0x00, 0xf0, 0x00,
  0x00, 0xf0, 0x00, 0x00, 0x60, 0x00, 0x00, 0x00, 0x00, 0x00, 0x00, 0x00
};

//-------------------------Icone de Wifi Off
static const unsigned char PROGMEM wifiOFF [] = {
  0x00, 0x00, 0x00, 0x00, 0x00, 0x00, 0x0c, 0x00, 0x00, 0x0e, 0x00, 0x00, 0x07, 0x7e, 0x00, 0x17,
  0x3f, 0x80, 0x7b, 0x87, 0xe0, 0x79, 0xc1, 0xf0, 0xe0, 0xec, 0x70, 0x0e, 0xef, 0x00, 0x1e, 0x77,
  0x80, 0x1c, 0x3b, 0x80, 0x03, 0xb8, 0x00, 0x03, 0xdc, 0x00, 0x03, 0x0e, 0x00, 0x00, 0x0e, 0x00,
  0x00, 0x66, 0x00, 0x00, 0x60, 0x00, 0x00, 0x00, 0x00, 0x00, 0x00, 0x00
};

//-------------------------Icone de MQTT On
static const unsigned char PROGMEM mqttON [] = {
  0x00, 0x00, 0x00, 0x00, 0x00, 0x00, 0x03, 0x80, 0x00, 0x07, 0xe0, 0x00, 0x0c, 0x3e, 0x00, 0x18,
  0x13, 0x00, 0x18, 0x01, 0x80, 0x70, 0x00, 0xe0, 0x40, 0x00, 0x20, 0xc0, 0x00, 0x20, 0xc0, 0x00,
  0x20, 0xc0, 0x00, 0x60, 0x60, 0x03, 0xc0, 0x38, 0x03, 0x80, 0x0c, 0x7e, 0x00, 0x07, 0xfc, 0x00,
  0x03, 0x80, 0x00, 0x00, 0x00, 0x00, 0x00, 0x00, 0x00, 0x00, 0x00, 0x00
};

//-------------------------Icone de MQTT Off
static const unsigned char PROGMEM mqttOFF [] = {
  0x00, 0x00, 0x00, 0x00, 0x00, 0x00, 0x00, 0x00, 0x00, 0x07, 0xc0, 0x00, 0x1c, 0x70, 0x00, 0x10,
  0x1e, 0x00, 0x30, 0x1f, 0x00, 0x20, 0x00, 0x80, 0x20, 0x60, 0xc0, 0x41, 0xf8, 0x20, 0xc3, 0x0c,
  0x10, 0x82, 0x04, 0x10, 0x80, 0x00, 0x10, 0x43, 0x04, 0x30, 0x72, 0x05, 0xe0, 0x01, 0x08, 0x00,
  0x00, 0xf0, 0x00, 0x00, 0x00, 0x00, 0x00, 0x00, 0x00, 0x00, 0x00, 0x00
};

//------------------------- MQTT
// Funcão para se conectar ao Broker MQTT
void initMQTT() {
  MQTT.setServer(BROKER_MQTT, BROKER_PORT);
  MQTT.setCallback(mqtt_callback);
}

//Função que recebe as mensagens publicadas
void mqtt_callback(char* topic, byte* payload, unsigned int length) {

  for (int i = 0; i < length; i++) {
    char c = (char)payload[i];
    message += c;
  }
  Serial.println("Tópico => " + String(topic) + " | Valor => " + String(message));

  //Serial.flush();
}

void reconnectMQTT()
{
  while (!MQTT.connected())
  {
    Serial.print("* Tentando se conectar ao Broker MQTT: ");
    Serial.println(BROKER_MQTT);

    if (MQTT.connect(ID_MQTT))
    {
      Serial.println("Conectado com sucesso ao broker MQTT!");
      MQTT.subscribe(TOPICO_SUBSCRIBE);
      //display.drawBitmap(100, 0, mqttON, 20, 20, WHITE);
    }
    else
    {
      Serial.println("Falha ao reconectar no broker.");
      Serial.println("Havera nova tentatica de conexao em 2s");
      //display.drawBitmap(100, 0, mqttOFF, 20, 20, WHITE);
      delay(1000);
    }
  }
}

void reconectWiFi()
{
  if (WiFi.status() == WL_CONNECTED) {
    return;
  }

  WiFi.begin(SSID, PASSWORD); // Conecta na rede WI-FI

  while (WiFi.status() != WL_CONNECTED)
  {
    delay(100);
    Serial.print(".");
    //display.drawBitmap(0, 0, wifiOFF, 20, 20, WHITE);
  }
  Serial.print("Conectado com sucesso na rede ");
  Serial.print(SSID);
  Serial.println("IP obtido: ");
  Serial.println(WiFi.localIP());
  //display.drawBitmap(0, 0, wifiON, 20, 20, WHITE);
}

//Nunca execute nada na interrupcao, apenas setar flags!
void tCallback(void *tCall) {
  _timeout = true;
}

void VerificaConexoesWiFIEMQTT(void)
{
  if (!MQTT.connected())
    reconnectMQTT();

  reconectWiFi();
}

void usrInit(void) {
  os_timer_setfn(&mTimer, tCallback, NULL);
  os_timer_arm(&mTimer, 5000, true);
}

void telaInicial(void) {
  display.clearDisplay();
  display.drawBitmap(30, 10, logoCAP, 126, 126, WHITE);
  display.display();
}

void setup() {
  Serial.begin(115200);
  Serial.println("Iniciando");
  delay(10);

  display.begin(SSD1306_SWITCHCAPVCC, 0x3C);
  display.clearDisplay();
  display.drawBitmap(30, 10, logoCAP, 126, 64, WHITE);
  display.display();
  //telaInicial();

  WiFi.begin(SSID, PASSWORD);

  while (WiFi.status() != WL_CONNECTED) {
    delay(500);
    Serial.print(".");
    //display.drawBitmap(0, 0, wifiOFF, 20, 20, WHITE);
  }

  irsend.begin();
  Serial.println("");
  Serial.println("WiFi connected");
  // display.clearDisplay();
  //display.drawBitmap(0, 0, wifiON, 20, 20, WHITE);

  Serial.println("DHT22 Iniciado!");
  dht.begin();  // Inicia sensor de temperatura e humidade DHTxx
  Serial.println("Interrupcao inciada");
  usrInit();    //INICIA A PRIMEIRA INTERRUPCAO
  initMQTT();
}
void readPIR()
{
  int leitura = digitalRead(PIN_PIR);

  if(leitura == LOW)
    countHERE++;
   
  if(leitura == HIGH && PIRbef == HIGH) //tem gente na sala;
  {     
    MQTT.publish(TOPICO_PUBLISH3, "TEM GENTE NA SALA"/*.c_str()*/); 
    //public
  }

  else if(leitura == LOW && PIRbef == LOW && countHERE >= 10)//não tem niguem na sala;
  {
    MQTT.publish(TOPICO_PUBLISH3, "NÂO GENTE NA SALA"/*.c_str()*/); 
    //public
  }

  PIRbef = leitura;
}
void loop() {
  /*
    if (!MQTT.connected()) {
      reconnectMQTT();
    }*/
  //========================================================================================================
  //Temperatura, Umidade e Luminosidade
  if (_timeout)
  {
    //Luminosidade
    ldrValor = analogRead(ldrPin); //O VALOR LIDO SERA ENTRE 0 E 1023
    ldrValor = map(ldrValor, 0, 1023, 100, 0);
    Serial.print("Luminosidade: ");
    Serial.print(ldrValor);
    Serial.print("% ");

    ldrValorSend = (float)ldrValor;
    ldrValorSend = ldrValorSend / 100;
    //Serial.print(ldrValorSend);

    //Temperatura, Umidade
    humid = dht.readHumidity();
    temp = dht.readTemperature();
    if (isnan(temp) || isnan(humid))
    {
      Serial.println("Failed to read from DHT");
    }
    else
    {
      Serial.print("Umidade: ");
      intHumid = (int)humid;
      Serial.print(intHumid);
      String umiMQTT = String(intHumid);
      Serial.print("% ");
      MQTT.publish(TOPICO_PUBLISH2, umiMQTT.c_str());
      Serial.print("Temperatura: ");
      intTemp = (int)temp;
      Serial.print(intTemp);
      String tempMQTT = String(intTemp);
      MQTT.publish(TOPICO_PUBLISH, tempMQTT.c_str());
      Serial.println("*C");
    }
    _timeout = false;
  }

  //Sinais AR CONDICIONADO
  uint16_t tam = 197, p = 38;

  if (message == "1")
  {
    irsend.sendRaw(Desligar, tam, p);
    Serial.println("Comando enviado: Desliga");
  }
  else if (message == "2")
  {
    irsend.sendRaw(Ligar20C, tam, p);
    Serial.println("Comando enviado: Liga a uma temperatura de 20°C");
  }
  else if (message == "3")
  {
    irsend.sendRaw(Temp16C, tam, p);
    Serial.println("Comando enviado: Temperatura a 16°C");
  }
  else if (message == "4")
  {
    irsend.sendRaw(Temp17C, tam, p);
    Serial.println("Comando enviado: Temperatura a 17°C");
  }
  else if (message == "5")
  {
    irsend.sendRaw(Temp18C, tam, p);
    Serial.println("Comando enviado: Temperatura a 18°C");
  }
  else if (message == "6")
  {
    irsend.sendRaw(Temp19C, tam, p);
    Serial.println("Comando enviado: Temperatura a 19°C");
  }
  else if (message == "7")
  {
    irsend.sendRaw(Temp20C, tam, p);
    Serial.println("Comando enviado: Temperatura a 20°C");
  }
  message = "";
  VerificaConexoesWiFIEMQTT();
  MQTT.loop();
}
